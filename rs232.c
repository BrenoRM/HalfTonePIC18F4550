/*			GCEM - LUCAS DIEGO					*/
/*	A APLICACAO CONSISTE EM UMA COMUNICACAO 	*/
/*	DA PLACA COM O COMPUTADOR ATRAVES DO 		*/
/*	PERIFERICO UART(PORTA SERIAL), NA QUAL		*/
/*	O QUE E DIGITADO NO TECLADO DA PLACA 		*/
/*	APARECE NO TERMINAL SERIAL(DOCKLIGHT)		*/
/*	E O CARACTERE QUE SE DIGITA NO TERMINAL		*/
/*	APARECE NO DISPLAY ALFANUMERICO				*/
/*												*/
/*		REQUISITOS PARA A UTILIZACAO			*/
/*			DA APLICACAO NA PLACA:				*/
/*		JUMPERS JP21 E JP22 NA POSICAO 1		*/
/*		DIG1 A DIG4 DESABILITADOS				*/
/*		APOS A GRAVACAO REMOVER O GRAVADOR 		*/
/*		PARA EVITAR CONFLITOS NOS PINOS			*/
/*		PGD E PGC								*/



// Bibliotecas
#include <P18F4550.h>
#include <usart.h>
#include <stdio.h>
#include <delays.h>
// Oscilador e outras definicoes de registradores	
#pragma config FOSC     = HS     // (8 MHz)
#pragma config IESO     = OFF
#pragma config PWRT     = OFF
#pragma config BORV     = 3
#pragma config WDT      = OFF
#pragma config WDTPS    = 32768
#pragma config MCLRE    = OFF
#pragma config LPT1OSC  = OFF
#pragma config PBADEN   = OFF
#pragma config STVREN   = ON
#pragma config LVP      = OFF

// Definições 
#define OUT 0		// definição de direção de I/O
#define IN 1		// definição de direção de I/O

// Definições de Hardware
// Para LCD
#define RS PORTEbits.RE0
#define EN PORTEbits.RE1
#define DISPLAY PORTD
#define RS_DIR DDREbits.RE0
#define EN_DIR DDREbits.RE1
#define DISPLAY_DIR DDRD

// Para Teclado
// Pinos
#define C0 	PORTBbits.RB0 
#define C1 	PORTBbits.RB1
#define C2 	PORTBbits.RB2
#define C3 	PORTBbits.RB3
#define L3 	PORTBbits.RB7
#define L2 	PORTBbits.RB6
#define L1 	PORTBbits.RB5
#define L0	PORTBbits.RB4
// Direção de dados dos pinos
#define C0_DIR	DDRBbits.RB0
#define C1_DIR	DDRBbits.RB1
#define C2_DIR	DDRBbits.RB2
#define C3_DIR	DDRBbits.RB3
#define L0_DIR	DDRBbits.RB4
#define L1_DIR	DDRBbits.RB5
#define L2_DIR	DDRBbits.RB6
#define L3_DIR	DDRBbits.RB7

#define WIDTH  114
#define HEIGHT 120
#define WIDTH_2  228
#define HEIGHT_2 240

rom unsigned char image[120][114] = { 
 { 111, 108, 109, 107, 075, 096, 079, 111, 111, 115, 111, 119, 076,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 121, 123 }, 
 { 115, 129, 076, 055, 078, 115, 121, 115, 115, 117, 114, 120, 053,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 118, 121 }, 
 { 101, 040, 049, 098, 115, 116, 113, 115, 115, 117, 116, 113, 048,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 121, 121 }, 
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 { 246, 244, 246, 242, 255, 160, 231, 247, 244, 245, 253, 178, 172,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 250, 250 }
};

//rom unsigned char image[120][114];
#pragma udata aux_array
    unsigned char aux[2][228];
#pragma udata
    
int done = 0;
int line = 0;

void printHalftoneForPixelLine()
{
    int i, j;
    
    for(i = 0; i < 2; i++)
    {
        for(j = 0; j < WIDTH_2; j++)
        {
            printf("%c", aux[i][j]);
        }
    }
}

void buildMatrixForPixelLine(int category, int col)
{
    switch(category){
        case 0:
            aux[0][2*col]       = 33;
            aux[0][(2*col) + 1] = 33;
            aux[1][2*col]       = 33;
            aux[1][(2*col) + 1] = 33;
            break;
            
        case 1:
            aux[0][2*col]       = 125;
            aux[0][(2*col) + 1] = 33;
            aux[1][2*col]       = 33;
            aux[1][(2*col) + 1] = 33;
            break;
            
        case 2:
            aux[0][2*col]       = 125;
            aux[0][(2*col) + 1] = 33;
            aux[1][2*col]       = 33;
            aux[1][(2*col) + 1] = 125;
            break;
            
        case 3:
            aux[0][2*col]       = 125;
            aux[0][(2*col) + 1] = 125;
            aux[1][2*col]       = 33;
            aux[1][(2*col) + 1] = 125;
            break;
            
        case 4:
            aux[0][2*col]       = 125;
            aux[0][(2*col) + 1] = 125;
            aux[1][2*col]       = 125;
            aux[1][(2*col) + 1] = 125;
            break;
    };
}

void calculaHalftone(int row)
{
    int col;
    unsigned char pixel;
    
    for (col = 0; col < WIDTH; col++)
    {
        pixel = image[row][col];
        
        if (pixel >= 0 && pixel <= 51)
        {
            buildMatrixForPixelLine(0, col);
        }
        else
        {
            if (pixel > 51 && pixel <= 102)
            {
                buildMatrixForPixelLine(1, col);
            }
            else
            {
                if (pixel > 102 && pixel <= 153)
                {
                    buildMatrixForPixelLine(2, col);
                }
                else
                {
                    if (pixel > 153 && pixel < 204)
                    {
                        buildMatrixForPixelLine(3, col);
                    }
                    else
                    {
                        buildMatrixForPixelLine(4, col);
                    }
                }
            }
        }
        
        //printf("processando pixel[0][%d]...\n\r", col);
    }
    
    //printf("Terminei halftone...\n\r");
}

void main (void)
{	
	LATD = 0x00;
	DDRD = 0x00;	

	OpenUSART(	USART_TX_INT_OFF & 
				USART_RX_INT_OFF & 
				USART_ASYNCH_MODE & 
				USART_EIGHT_BIT &
				USART_CONT_RX &
				USART_BRGH_HIGH,50);

	while(1) 
	{       
       if (done == 0)
       {
           printf("P2\n\r");
           printf("# CREATOR: Francis e Brm\n\r");
           printf("%d %d\n\r", WIDTH_2, HEIGHT_2);
           printf("128\n\r\n\r");
           for(line = 0; line < HEIGHT; line++)
           {
                //printf("calculando halftone linha[%d]:\n\r", line);
                calculaHalftone(line);

                //printf("imprimindo matriz: \n\r");
                printHalftoneForPixelLine();
           }

           done = 1;
       } 
	}
}